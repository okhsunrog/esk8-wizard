## main/Kconfig.projbuild
```kconfig
menu "esk8-wizard Config"

    orsource "Kconfig.env_caps"

    config CAN_RX_GPIO
        int "CAN RX GPIO number"
        range ENV_GPIO_RANGE_MIN ENV_GPIO_OUT_RANGE_MAX
        default 9
        help
            GPIO number (IOxx) to connect ESP to CAN transceiver.
            Some GPIOs are used for other purposes (USB, flash connections, etc.) and cannot be used for CAN.

    config CAN_TX_GPIO
        int "CAN TX GPIO number"
        range ENV_GPIO_RANGE_MIN ENV_GPIO_OUT_RANGE_MAX
        default 8
        help
            GPIO number (IOxx) to connect ESP to CAN transceiver.
            Some GPIOs are used for other purposes (USB, flash connections, etc.) and cannot be used for CAN.

    config LED_STRIP_GPIO
        int "LED strip GPIO number"
        range ENV_GPIO_RANGE_MIN ENV_GPIO_OUT_RANGE_MAX
        default 13

    config LED_NUM
        int "Number of LEDs in led strip"
        range 1 1000
        default 10

    config DEVICE_ID
        int "Device ID on CAN bus"
        range 1 254
        default 110

    config STATUS_TASK_PRIORITY
        int "Status task priority"
        range 0 22
        default 10
        help
            A priority of FreeRTOS task status_changer_task. See more about tasks priorities in FreeRTOS documentation.

    config CAN_TASK_PRIORITY
        int "CAN task priority"
        range 0 22
        default 15
        help
            A priority of FreeRTOS task can_task. See more about tasks priorities in FreeRTOS documentation.

    config GAME_TASK_PRIORITY
        int "Game task priority"
        range 0 22
        default 9
        help
            A priority of FreeRTOS task game_task. See more about tasks priorities in FreeRTOS documentation.

endmenu
```
